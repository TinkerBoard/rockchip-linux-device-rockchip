/dts-v1/;
/plugin/;
/ {
	compatible = "rockchip,rk3288-evb-rk808-linux", "rockchip,rk3288";

	fragment@0 {
		target = <&dsi0>;
		__overlay__ {
			mipi_panel: mipi-panel {
				waveshare_5inch;
			};
		};
	};
};
